## CMakeLists.txt
```
cmake_minimum_required(VERSION 3.20.0)

find_package(Zephyr)
project(wifi_sta_mqtt_dpm)

target_sources(app PRIVATE 
	src/main.c
	src/renesas_mqtt_test.c
)
```

## prj.conf
```kconfig
# Copyright (c) 2025 Renesas Electronics Corporation
# SPDX-License-Identifier: Apache-2.0

CONFIG_POSIX_API=y
CONFIG_EVENTS=y

# Wi-Fi Configuration
CONFIG_WIFI=y

# GPIO Configuration
CONFIG_GPIO=y

# Network Configuration
CONFIG_NETWORKING=y
CONFIG_NET_NATIVE=y
CONFIG_NET_IPV4=y
CONFIG_NET_IPV6=n
CONFIG_NET_TCP=y
CONFIG_NET_DHCPV4=y
CONFIG_NET_CONFIG_AUTO_INIT=n

# Network management
CONFIG_NET_MGMT=y
CONFIG_NET_MGMT_EVENT=y
CONFIG_NET_MGMT_EVENT_INFO=y
CONFIG_NET_MGMT_EVENT_QUEUE_SIZE=10
CONFIG_NET_MGMT_EVENT_STACK_SIZE=4096
CONFIG_NET_CONNECTION_MANAGER=y

# Enable the MQTT Lib
CONFIG_MQTT_LIB=y

# Network buffers
CONFIG_NET_PKT_RX_COUNT=16
CONFIG_NET_PKT_TX_COUNT=16

# L2 drivers
CONFIG_NET_L2_ETHERNET=y
CONFIG_NET_L2_WIFI_MGMT=y

# LOG Configuration
CONFIG_LOG=y
CONFIG_LOG_BUFFER_SIZE=4096
CONFIG_NET_LOG=y
CONFIG_WIFI_LOG_LEVEL_DBG=y
CONFIG_NET_SOCKETS_LOG_LEVEL_DBG=n
CONFIG_NET_L2_WIFI_MGMT_LOG_LEVEL_DBG=n
```

## boards/ek_ra6m4.overlay
```dts
/*
 * Copyright (c) 2025 Renesas Electronics Corporation
 *
 * SPDX-License-Identifier: Apache-2.0
 *
 * Device tree overlay for GPIO wakeup on P206
 */

/ {
    aliases {
        wakeup-gpio = &gpio_wakeup;
    };

    gpio_wakeup {
        compatible = "gpio-leds";
        gpio_wakeup: wakeup_gpio {
            gpios = <&ioport2 6 GPIO_ACTIVE_LOW>;
            label = "Wakeup GPIO P206";
        };
    };
};
```

## src/main.c
```c
/*
 * Copyright (c) 2025 Renesas Electronics Corporation
 *
 * SPDX-License-Identifier: Apache-2.0
 */

#include <errno.h>
#include <stdio.h>
#include <string.h>

#include <zephyr/drivers/gpio.h>
#include <zephyr/kernel.h>
#include <zephyr/logging/log.h>
#include <zephyr/net/net_if.h>
#include <zephyr/net/socket.h>
#include <zephyr/net/wifi_mgmt.h>

LOG_MODULE_REGISTER(main, LOG_LEVEL_DBG);

/* Wi-Fi network configuration */

#define WIFI_SSID            "TP-Link_1218" 
#define WIFI_PSK             "74512829"

/* TCP server configuration */
#define SERVER_IP "192.168.56.1"
#define SERVER_PORT 10001

/* Test message configuration */
#define TX_MESSAGE_LEN_MAX 32
#define RX_MESSAGE_LEN_MAX 32

/* Wi-Fi connection events */
#define WIFI_EVENT_CONNECT_SUCCESS BIT(0)
#define WIFI_EVENT_CONNECT_FAILED BIT(1)
#define WIFI_EVENT_ALL (WIFI_EVENT_CONNECT_SUCCESS | WIFI_EVENT_CONNECT_FAILED)
#define NET_EVENT_ALL (NET_EVENT_IPV4_ADDR_ADD | NET_EVENT_IPV4_DHCP_BOUND)

/* GPIO wakeup configuration */
#define GPIO_WAKEUP_NODE DT_ALIAS(wakeup_gpio)
#define GPIO_WAKEUP_PORT DT_GPIO_CTLR(GPIO_WAKEUP_NODE, gpios)
#define GPIO_WAKEUP_PIN DT_GPIO_PIN(GPIO_WAKEUP_NODE, gpios)
#define GPIO_WAKEUP_FLAGS DT_GPIO_FLAGS(GPIO_WAKEUP_NODE, gpios)
#define WAKEUP_PULSE_DURATION_MS 20 /* Active low for 20 milliseconds */

static void print_wifi_status(struct wifi_iface_status *status);

static struct net_mgmt_event_callback cb;
static struct net_mgmt_event_callback cb1;

K_EVENT_DEFINE(connect_event);
K_EVENT_DEFINE(net_event);

extern int is_subscribed;
void erpc_wifi_gpio_trigger_wakeup(void);
const struct device *g_gpio_wakeup_dev;

struct k_mutex erpc_mutex;

int wifi_ps_set(struct net_if *iface, struct wifi_ps_params *p) {
  LOG_INF("Setting Wi-Fi Power Save: type=%d", p->type);
  k_mutex_lock(&erpc_mutex, K_FOREVER);
  int rc = net_mgmt(NET_REQUEST_WIFI_PS, iface, p, sizeof(*p));
  k_mutex_unlock(&erpc_mutex);
  if (rc) {
    LOG_INF("NET_REQUEST_WIFI_PS failed type=%d rc=%d", p->type, rc);
  } else {
    LOG_INF("Wi-Fi PS set type=%d OK", p->type);
  }
  return rc;
}
int wifi_ps_state_set(struct net_if *iface, bool enable) {
  struct wifi_ps_params p = {0};

  p.type = WIFI_PS_PARAM_STATE;
  p.enabled = enable ? WIFI_PS_ENABLED : WIFI_PS_DISABLED;
  p.listen_interval = 20;

  return wifi_ps_set(iface, &p);
}
void erpc_wifi_gpio_trigger_wakeup(void) {
  // gpio_trigger_wakeup(g_gpio_wakeup_dev);
}
static void set_active_mode(struct net_if *iface) {
  LOG_INF("Setting ACTIVE mode (PS disabled, keep RA awake)...");

  wifi_ps_state_set(iface, false);

  struct wifi_ps_params p = {0};

  p.type = WIFI_PS_PARAM_WAKEUP_MODE;
  p.wakeup_mode = WIFI_PS_WAKEUP_MODE_DTIM;
  wifi_ps_set(iface, &p);
  p.type = WIFI_PS_PARAM_TIMEOUT;
  p.timeout_ms = 0;
  wifi_ps_set(iface, &p);
}

void set_low_power_mode(struct net_if *iface, uint16_t listen_interval,
                        uint32_t timeout_ms) {
  LOG_INF("Setting LOW POWER mode (DPM)...");
  struct wifi_ps_params p = {0};

  p.type = WIFI_PS_PARAM_LISTEN_INTERVAL;
  p.listen_interval = listen_interval;
  wifi_ps_set(iface, &p);

  p.type = WIFI_PS_PARAM_WAKEUP_MODE;
  p.wakeup_mode = WIFI_PS_WAKEUP_MODE_LISTEN_INTERVAL;
  wifi_ps_set(iface, &p);
  p.type = WIFI_PS_PARAM_EXIT_STRATEGY;
  p.exit_strategy = WIFI_PS_EXIT_EVERY_TIM;
  wifi_ps_set(iface, &p);
  p.type = WIFI_PS_PARAM_TIMEOUT;
  p.timeout_ms = timeout_ms;
  wifi_ps_set(iface, &p);
  wifi_ps_state_set(iface, true);
}

/**
 * @brief Initialize GPIO wakeup pin
 * @return 0 on success, negative on failure
 */
static int gpio_wakeup_init(const struct device **gpio_dev) {
  *gpio_dev = DEVICE_DT_GET(GPIO_WAKEUP_PORT);

  if (!device_is_ready(*gpio_dev)) {
    LOG_ERR("GPIO device not ready");
    return -ENODEV;
  }

  int ret = gpio_pin_configure(*gpio_dev, GPIO_WAKEUP_PIN,
                               GPIO_OUTPUT_HIGH | GPIO_WAKEUP_FLAGS);
  if (ret < 0) {
    LOG_ERR("Failed to configure GPIO wakeup pin: %d", ret);
    return ret;
  }

  LOG_INF("GPIO wakeup pin initialized (pin: %d)", GPIO_WAKEUP_PIN);
  return 0;
}

/**
 * @brief Trigger wakeup pulse on GPIO (active low for 20ms)
 */
void gpio_trigger_wakeup(const struct device *gpio_dev) {
  if (gpio_dev == NULL) {
    LOG_WRN("GPIO device not initialized");
    return;
  }

  LOG_INF("Triggering wakeup pulse on GPIO pin %d (active low for %dms)",
          GPIO_WAKEUP_PIN, WAKEUP_PULSE_DURATION_MS);

  gpio_pin_set(gpio_dev, GPIO_WAKEUP_PIN, 1);
  k_msleep(WAKEUP_PULSE_DURATION_MS);
  gpio_pin_set(gpio_dev, GPIO_WAKEUP_PIN, 0);
  LOG_INF("Wakeup pulse completed");
}

/**
 * @brief Enter sleep mode and wait for GPIO wakeup
 */
static void enter_sleep_mode(const struct device *gpio_dev) {
  LOG_INF(
      "Entering sleep mode... Press wakeup button or wait for GPIO trigger");
  LOG_INF("Device will wake up when GPIO pin goes active low for %dms",
          WAKEUP_PULSE_DURATION_MS);

  k_msleep(10000);

  LOG_INF("Exiting sleep mode");
}

static void wifi_event_handler(struct net_mgmt_event_callback *cb,
                               uint64_t mgmt_event, struct net_if *iface) {
  const struct wifi_status *status = (const struct wifi_status *)cb->info;

  LOG_INF("Wi-Fi event - layer: %llx code: %llx cmd: %llx status: %d",
          NET_MGMT_GET_LAYER(mgmt_event), NET_MGMT_GET_LAYER_CODE(mgmt_event),
          NET_MGMT_GET_COMMAND(mgmt_event), status->status);

  switch (mgmt_event) {
  case NET_EVENT_WIFI_CONNECT_RESULT:
    if (status->status == 0) {
      LOG_INF("Connected to AP!");
      k_event_set(&connect_event, WIFI_EVENT_CONNECT_SUCCESS);
    } else {
      LOG_INF("Failed to connect to AP!");
      k_event_set(&connect_event, WIFI_EVENT_CONNECT_FAILED);
    }
    break;
  default:
    break;
  }
}

static void net_event_handler(struct net_mgmt_event_callback *cb,
                              uint64_t mgmt_event, struct net_if *iface) {
  const struct wifi_status *status = (const struct wifi_status *)cb->info;

  LOG_INF("NET event - layer: %llx code: %llx cmd: %llx status: %d",
          NET_MGMT_GET_LAYER(mgmt_event), NET_MGMT_GET_LAYER_CODE(mgmt_event),
          NET_MGMT_GET_COMMAND(mgmt_event), status->status);

  switch (mgmt_event) {
  case NET_EVENT_IPV4_ADDR_ADD:
    k_event_set(&net_event, NET_EVENT_IPV4_ADDR_ADD);
    LOG_INF("IPv4 address added");
    break;
  case NET_EVENT_IPV4_DHCP_BOUND:
    k_event_set(&net_event, NET_EVENT_IPV4_DHCP_BOUND);
    LOG_INF("DHCP bound - we have an IP address!");
    break;
  default:
    break;
  }
}

static void dhcp_event_handler(struct net_mgmt_event_callback *cb,
                               uint32_t mgmt_event, struct net_if *iface) {
  if (mgmt_event == NET_EVENT_IPV4_DHCP_BOUND) {
    LOG_INF("DHCP bound - we have an IP address!");

    // Get the assigned IP
    struct in_addr *addr =
        net_if_ipv4_get_global_addr(iface, NET_ADDR_PREFERRED);
    if (addr) {
      char ip_str[NET_IPV4_ADDR_LEN];
      net_addr_ntop(AF_INET, addr, ip_str, sizeof(ip_str));
      LOG_INF("IP Address: %s", ip_str);
    }
  }
}

extern int connect_to_broker(void);
int main(void) {
  int fd;
  int bytes_sent;
  int bytes_recvd;
  struct net_if *iface;
  struct in_addr *if_addr;
  struct wifi_connect_req_params config = {0};
  struct wifi_iface_status status = {0};
  struct wifi_version version = {0};
  const struct device *gpio_wakeup_dev = NULL;
  uint32_t events;
  char if_addr_s[NET_IPV4_ADDR_LEN];

  LOG_INF("Starting Wi-Fi station MQTT client...");

  iface = net_if_get_wifi_sta();
  if (iface == NULL) {
    LOG_INF("Cannot find the Wi-Fi interface");
    return 0;
  }

  k_mutex_init(&erpc_mutex);

  if (gpio_wakeup_init(&gpio_wakeup_dev) != 0) {
    LOG_WRN("Failed to initialize GPIO wakeup pin, continuing without it");
  }
  g_gpio_wakeup_dev = gpio_wakeup_dev;

  LOG_INF("Setting Listen interval...\n");
  struct wifi_ps_params p = {0};
  p.type = WIFI_PS_PARAM_LISTEN_INTERVAL;
  p.listen_interval = 10;
  wifi_ps_set(iface, &p);

  k_msleep(1000);

  net_mgmt_init_event_callback(&cb, wifi_event_handler,
                               NET_EVENT_WIFI_CONNECT_RESULT);
  net_mgmt_add_event_callback(&cb);

  net_mgmt_init_event_callback(&cb1, net_event_handler,
                               NET_EVENT_IPV4_ADDR_ADD |
                                   NET_EVENT_IPV4_DHCP_BOUND);
  net_mgmt_add_event_callback(&cb1);

  if (net_mgmt(NET_REQUEST_WIFI_VERSION, iface, &version, sizeof(version)) ==
      0) {
    LOG_INF("Wi-Fi Driver Version: %s", version.drv_version);
    LOG_INF("Wi-Fi Firmware Version: %s", version.fw_version);
  }

  config.ssid = (const uint8_t *)WIFI_SSID;
  config.ssid_length = strlen(WIFI_SSID);
  config.psk = (const uint8_t *)WIFI_PSK;
  config.psk_length = strlen(WIFI_PSK);
  config.security = WIFI_SECURITY_TYPE_PSK;
  config.channel = WIFI_CHANNEL_ANY;
  config.band = WIFI_FREQ_BAND_2_4_GHZ;

  do {
    LOG_INF("Connecting to network (SSID: %s)", config.ssid);

    if (net_mgmt(NET_REQUEST_WIFI_CONNECT, iface, &config,
                 sizeof(struct wifi_connect_req_params))) {
      LOG_INF("Wi-Fi connect request failed");
      return 0;
    }

    events = k_event_wait(&connect_event, WIFI_EVENT_ALL, true, K_FOREVER);
    if (events == WIFI_EVENT_CONNECT_SUCCESS) {
      LOG_INF("Joined network!");
      break;
    }
  } while (1);

  do {
    events = k_event_wait(&net_event, NET_EVENT_ALL, true, K_FOREVER);
    if (events & NET_EVENT_IPV4_DHCP_BOUND) {
      LOG_INF("DHCP lease received!");
      break;
    }
  } while (1);

#if defined(CONFIG_SHIELD_RENESAS_QCIOT_RRQ61051EVZ_PMOD)
  do {
    LOG_INF("Waiting for IP address to be assigned...");

    if_addr = net_if_ipv4_get_global_addr(iface, NET_ADDR_PREFERRED);

    if (if_addr) {
      net_addr_ntop(AF_INET, if_addr->s4_addr, if_addr_s, sizeof(if_addr_s));
      LOG_INF("Address: %s", if_addr_s);
    } else {
      k_msleep(1000);
    }
  } while (if_addr == NULL);
#else
  k_msleep(3000);
#endif

  if (net_mgmt(NET_REQUEST_WIFI_IFACE_STATUS, iface, &status,
               sizeof(struct wifi_iface_status))) {
    LOG_INF("Wi-Fi iface status request failed");
    return 0;
  }
  print_wifi_status(&status);

  connect_to_broker();

  while (1) {
    k_msleep(3000);
  }

  return 0;
}

static void print_wifi_status(struct wifi_iface_status *status) {
  LOG_INF("wifi_iface_status - state: %s", wifi_state_txt(status->state));
  LOG_INF("wifi_iface_status - ssid_len: %d", status->ssid_len);
  LOG_INF("wifi_iface_status - ssid: %s", status->ssid);
  LOG_INF("wifi_iface_status - bssid: %x:%x:%x:%x:%x:%x", status->bssid[0],
          status->bssid[1], status->bssid[2], status->bssid[3],
          status->bssid[4], status->bssid[5]);
  LOG_INF("wifi_iface_status - band: %s", wifi_band_txt(status->band));
  LOG_INF("wifi_iface_status - channel: %d", status->channel);
  LOG_INF("wifi_iface_status - iface_mode: %s",
          wifi_mode_txt(status->iface_mode));
  LOG_INF("wifi_iface_status - link_mode: %s",
          wifi_link_mode_txt(status->link_mode));
  LOG_INF("wifi_iface_status - security: %s",
          wifi_wpa3_enterprise_txt(status->wpa3_ent_type));
  LOG_INF("wifi_iface_status - security: %s",
          wifi_security_txt(status->security));
  LOG_INF("wifi_iface_status - mfp: %s", wifi_mfp_txt(status->mfp));
  LOG_INF("wifi_iface_status - rssi: %d", status->rssi);
  LOG_INF("wifi_iface_status - dtim_period: %d", status->dtim_period);
  LOG_INF("wifi_iface_status - beacon_interval: %d", status->beacon_interval);
  LOG_INF("wifi_iface_status - twt_capable: %d", status->twt_capable);
  LOG_INF("wifi_iface_status - current_phy_tx_rate: %f",
          (double)status->current_phy_tx_rate);
}
```

## src/renesas_mqtt_test.c
```c
#include <errno.h>
#include <stdbool.h>
#include <string.h>
#include <zephyr/drivers/gpio.h>
#include <zephyr/kernel.h>
#include <zephyr/logging/log.h>
#include <zephyr/net/mqtt.h>
#include <zephyr/net/net_if.h>
#include <zephyr/net/socket.h>
#include <zephyr/net/wifi_mgmt.h>

LOG_MODULE_REGISTER(mqtt_test, LOG_LEVEL_DBG);

#define MQTT_CLIENTID "--->>> zephyr MQTT client <<<---"
#define MQTT_BROKER_ADDR "192.168.28.165"
#define MQTT_BROKER_PORT 1883

#define MQTT_LOOP_TOPIC "rrq_sub"
#define MQTT_PUB_QOS MQTT_QOS_0_AT_MOST_ONCE
#define DPM_LISTEN_INTERVAL 10
#define DPM_TIMEOUT_MS 100
#define MQTT_WAKE_SETTLE_MS 1000
#define PUBLISH_LOOP_DELAY_MS 10000

extern const struct device *g_gpio_wakeup_dev;
extern struct k_mutex erpc_mutex;

static struct mqtt_client client;
static struct sockaddr_storage broker;
static uint8_t rx_buffer[256];
static uint8_t tx_buffer[256];

static bool can_publish;
static bool in_dpm;
static bool publish_loop_enabled;
static bool first_publish_done;
static bool dpm_profile_configured;

int wifi_ps_state_set(struct net_if *iface, bool enable);
void gpio_trigger_wakeup(const struct device *gpio_dev);
void set_low_power_mode(struct net_if *iface, uint16_t listen_interval,
                        uint32_t timeout_ms);

int is_subscribed = 0;
int is_mqtt_connected = 0;

static void enter_dpm_mode(void) {
  if (!is_mqtt_connected) {
    return;
  }

  if (!dpm_profile_configured) {
    set_low_power_mode(net_if_get_wifi_sta(), DPM_LISTEN_INTERVAL,
                       DPM_TIMEOUT_MS);
    dpm_profile_configured = true;
  } else {
    wifi_ps_state_set(net_if_get_wifi_sta(), true);
  }

  in_dpm = true;
  LOG_INF("DPM enabled");
}

static void wake_for_mqtt_io(const char *reason) {
  LOG_INF("Wake reason: %s", reason);

  if (g_gpio_wakeup_dev != NULL) {
    gpio_trigger_wakeup(g_gpio_wakeup_dev);
  }

  wifi_ps_state_set(net_if_get_wifi_sta(), false);

  k_msleep(MQTT_WAKE_SETTLE_MS);

  in_dpm = false;
}

static int mqtt_publish_data(const uint8_t *payload, size_t payload_len) {
  int ret;
  struct mqtt_publish_param param = {0};

  if (!can_publish) {
    LOG_WRN("Skipping publish because client is not ready");
    return -EAGAIN;
  }

  param.message.topic.qos = MQTT_PUB_QOS;
  param.message.topic.topic.utf8 = (uint8_t *)MQTT_LOOP_TOPIC;
  param.message.topic.topic.size = strlen(MQTT_LOOP_TOPIC);
  param.message.payload.data = (uint8_t *)payload;
  param.message.payload.len = payload_len;
  param.message_id = 666;
  param.dup_flag = 0;
  param.retain_flag = 0;

  LOG_INF("Publishing %d bytes to topic %s", payload_len, MQTT_LOOP_TOPIC);
  k_mutex_lock(&erpc_mutex, K_FOREVER);
  ret = mqtt_publish(&client, &param);
  k_mutex_unlock(&erpc_mutex);

  if (ret) {
    LOG_ERR("mqtt_publish failed: %d (%s)", ret, strerror(-ret));
  }

  return ret;
}

static ssize_t handle_published_message(struct mqtt_client *mqtt,
                                        const struct mqtt_publish_param *pub) {
  int ret;
  size_t received = 0u;
  size_t message_len = pub->message.payload.len;
  static uint8_t payload_buf[1024];

  LOG_INF("Received topic %.*s payload %u B", pub->message.topic.topic.size,
          (const char *)pub->message.topic.topic.utf8, message_len);

  do {
    ret = mqtt_read_publish_payload_blocking(mqtt, &payload_buf[received],
                                             message_len - received);
    if (ret == 0) {
      break;
    }

    if (ret == -EAGAIN) {
      continue;
    }

    if (ret < 0) {
      LOG_ERR("mqtt_read_publish_payload_blocking failed: %d", ret);
      return ret;
    }

    received += ret;
  } while (received < message_len);

  if (received != message_len) {
    LOG_ERR("Received data size mismatch %d != %d", received, message_len);
    return -ESPIPE;
  }

  LOG_HEXDUMP_INF(payload_buf, received, "RX payload");

  switch (pub->message.topic.qos) {
  case MQTT_QOS_0_AT_MOST_ONCE:
    break;
  case MQTT_QOS_1_AT_LEAST_ONCE:
    mqtt_publish_qos1_ack(mqtt, &(struct mqtt_puback_param){pub->message_id});
    break;
  case MQTT_QOS_2_EXACTLY_ONCE:
    mqtt_publish_qos2_receive(mqtt,
                              &(struct mqtt_pubrec_param){pub->message_id});
    break;
  default:
    break;
  }

  return received;
}

static void mqtt_evt_handler(struct mqtt_client *const c,
                             const struct mqtt_evt *evt) {
  int ret;
  struct mqtt_subscription_list list;
  struct mqtt_topic topics;

  switch (evt->type) {
  case MQTT_EVT_CONNACK:
    if (evt->result == 0) {
      topics.topic.utf8 = (uint8_t *)MQTT_LOOP_TOPIC;
      topics.topic.size = strlen(MQTT_LOOP_TOPIC);
      topics.qos = MQTT_QOS_0_AT_MOST_ONCE;

      list.list = &topics;
      list.list_count = 1;
      list.message_id = 1;

      is_mqtt_connected = 1;
      ret = mqtt_subscribe(c, &list);
      LOG_INF("mqtt_subscribe: %d (%s)", ret, ret ? strerror(-ret) : "ok");
    } else {
      LOG_ERR("MQTT connect failed (%d)", evt->result);
    }
    break;

  case MQTT_EVT_DISCONNECT:
    LOG_INF("MQTT disconnected");
    can_publish = false;
    is_mqtt_connected = 0;
    is_subscribed = 0;
    publish_loop_enabled = false;
    first_publish_done = false;
    dpm_profile_configured = false;
    break;

  case MQTT_EVT_SUBACK:
    LOG_INF("MQTT SUBACK message_id: %d", evt->param.suback.message_id);
    can_publish = true;
    is_subscribed = 1;
    publish_loop_enabled = true;
    first_publish_done = false;
    break;

  case MQTT_EVT_PINGRESP:
    LOG_DBG("PONG");
    break;

  case MQTT_EVT_PUBLISH:
    LOG_INF("MQTT PUBLISH event");
    handle_published_message(c, &evt->param.publish);
    break;

  default:
    LOG_DBG("Unhandled MQTT event: %d", evt->type);
    break;
  }
}

static int mqtt_drain_input(struct mqtt_client *mqtt) {
  int rc;

  k_mutex_lock(&erpc_mutex, K_FOREVER);
  rc = mqtt_input(mqtt);
  k_mutex_unlock(&erpc_mutex);

  if (rc == -EAGAIN || rc == 0) {
    return 0;
  }

  if (rc < 0) {
    LOG_ERR("mqtt_input failed: %d (%s)", rc, strerror(-rc));
    return rc;
  }

  return 0;
}

static void mqtt_comm_thread(void *arg1, void *arg2, void *arg3) {
  struct mqtt_client *mqtt = arg1;
  static const uint8_t hello_payload[] = "hello";

  ARG_UNUSED(arg2);
  ARG_UNUSED(arg3);

  LOG_INF("MQTT loop thread started");

  for (;;) {
    if (mqtt->transport.tcp.sock <= 0) {
      k_sleep(K_MSEC(1000));
      continue;
    }

    if (!publish_loop_enabled) {
      mqtt_drain_input(mqtt);
      k_sleep(K_MSEC(100));
      continue;
    }

    if (!first_publish_done) {
      wake_for_mqtt_io("initial publish after SUBACK");
      mqtt_publish_data(hello_payload, sizeof(hello_payload) - 1);
      enter_dpm_mode();
      first_publish_done = true;
      continue;
    }

    k_sleep(K_MSEC(PUBLISH_LOOP_DELAY_MS));
    wake_for_mqtt_io("periodic publish");
    mqtt_publish_data(hello_payload, sizeof(hello_payload) - 1);
    enter_dpm_mode();
  }
}

#define CONFIG_MQTT_THREAD_STACK_SIZE 3200
#define MQTT_THREAD_PRIORITY 5
K_THREAD_DEFINE(mqtt_thread, K_THREAD_STACK_LEN(CONFIG_MQTT_THREAD_STACK_SIZE),
                mqtt_comm_thread, &client, NULL, NULL, MQTT_THREAD_PRIORITY, 0,
                0);

int connect_to_broker(void) {
  struct sockaddr_in *broker4 = (struct sockaddr_in *)&broker;

  broker4->sin_family = AF_INET;
  broker4->sin_port = htons(MQTT_BROKER_PORT);
  inet_pton(AF_INET, MQTT_BROKER_ADDR, &broker4->sin_addr);

  mqtt_client_init(&client);

  client.broker = &broker;
  client.evt_cb = mqtt_evt_handler;
  client.client_id.utf8 = (uint8_t *)MQTT_CLIENTID;
  client.client_id.size = strlen(MQTT_CLIENTID);
  client.keepalive = 1000;
  client.protocol_version = MQTT_VERSION_3_1_1;

  client.rx_buf = rx_buffer;
  client.rx_buf_size = sizeof(rx_buffer);
  client.tx_buf = tx_buffer;
  client.tx_buf_size = sizeof(tx_buffer);
  client.transport.type = MQTT_TRANSPORT_NON_SECURE;

  k_mutex_lock(&erpc_mutex, K_FOREVER);
  int ret = mqtt_connect(&client);
  k_mutex_unlock(&erpc_mutex);

  if (ret) {
    LOG_ERR("mqtt_connect failed: %d (%s)", ret, strerror(-ret));
    return ret;
  }

  LOG_INF("MQTT connected socket=%d", client.transport.tcp.sock);
  return 0;
}
```

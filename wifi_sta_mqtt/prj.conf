## CMakeLists.txt
```
cmake_minimum_required(VERSION 3.20.0)

find_package(Zephyr)
project(wifi_sta_tcp_client)

target_sources(app PRIVATE 
	src/main.c
	src/renesas_mqtt_test.c
)
```

## prj.conf
```kconfig
# Copyright (c) 2025 Renesas Electronics Corporation
# SPDX-License-Identifier: Apache-2.0

CONFIG_POSIX_API=y
CONFIG_EVENTS=y

# Wi-Fi Configuration
CONFIG_WIFI=y

# Network Configuration
CONFIG_NETWORKING=y
CONFIG_NET_NATIVE=y
CONFIG_NET_IPV4=y
CONFIG_NET_IPV6=n
CONFIG_NET_IPV6_DAD=n
CONFIG_NET_TCP=y
CONFIG_NET_DHCPV4=y
CONFIG_NET_CONFIG_AUTO_INIT=n

# Network management
CONFIG_NET_MGMT=y
CONFIG_NET_MGMT_EVENT=y
CONFIG_NET_MGMT_EVENT_INFO=y
CONFIG_NET_MGMT_EVENT_QUEUE_SIZE=10
CONFIG_NET_MGMT_EVENT_STACK_SIZE=4096
CONFIG_NET_CONNECTION_MANAGER=y

# Enable the MQTT Lib
CONFIG_MQTT_LIB=y

# Network buffers
CONFIG_NET_PKT_RX_COUNT=16
CONFIG_NET_PKT_TX_COUNT=16

# L2 drivers
CONFIG_NET_L2_ETHERNET=y
CONFIG_NET_L2_WIFI_MGMT=y

# LOG Configuration
CONFIG_LOG=y
CONFIG_LOG_BUFFER_SIZE=4096
CONFIG_NET_LOG=y
CONFIG_WIFI_LOG_LEVEL_DBG=y
CONFIG_NET_SOCKETS_LOG_LEVEL_DBG=n
CONFIG_NET_L2_WIFI_MGMT_LOG_LEVEL_DBG=n
```

## src/main.c
```c
/*
 * Copyright (c) 2025 Renesas Electronics Corporation
 *
 * SPDX-License-Identifier: Apache-2.0
 */

#include <stdio.h>
#include <zephyr/kernel.h>
#include <zephyr/net/net_if.h>
#include <zephyr/net/socket.h>
#include <zephyr/net/wifi_mgmt.h>

#include <zephyr/logging/log.h>
LOG_MODULE_REGISTER(main, LOG_LEVEL_DBG);

/* Wi-Fi network configuration */
/* Wi-Fi network configuration */
#define WIFI_SSID "TP-Link_1218"
#define WIFI_PSK "74512829"

/* TCP server configuration */
#define SERVER_IP "192.168.31.224"
#define SERVER_PORT 10001

/* Test message configuration */
#define TX_MESSAGE_LEN_MAX 32
#define RX_MESSAGE_LEN_MAX 32

/* Wi-Fi connection events */
#define WIFI_EVENT_CONNECT_SUCCESS BIT(0)
#define WIFI_EVENT_CONNECT_FAILED BIT(1)
#define WIFI_EVENT_ALL (WIFI_EVENT_CONNECT_SUCCESS | WIFI_EVENT_CONNECT_FAILED)
#define NET_EVENT_ALL (NET_EVENT_IPV4_ADDR_ADD | NET_EVENT_IPV4_DHCP_BOUND)

static void print_wifi_status(struct wifi_iface_status *status);

static struct net_mgmt_event_callback cb;
static struct net_mgmt_event_callback cb1;

K_EVENT_DEFINE(connect_event);
K_EVENT_DEFINE(net_event);

static void wifi_event_handler(struct net_mgmt_event_callback *cb,
                               uint64_t mgmt_event, struct net_if *iface) {
  const struct wifi_status *status = (const struct wifi_status *)cb->info;

  LOG_INF("Wi-Fi event - layer: %llx code: %llx cmd: %llx status: %d",
          NET_MGMT_GET_LAYER(mgmt_event), NET_MGMT_GET_LAYER_CODE(mgmt_event),
          NET_MGMT_GET_COMMAND(mgmt_event), status->status);

  switch (mgmt_event) {
  case NET_EVENT_WIFI_CONNECT_RESULT:
    if (status->status == 0) {
      LOG_INF("Connected to AP!");
      k_event_set(&connect_event, WIFI_EVENT_CONNECT_SUCCESS);
    } else {
      LOG_INF("Failed to connect to AP!");
      k_event_set(&connect_event, WIFI_EVENT_CONNECT_FAILED);
    }
    break;
  default:
    break;
  }
}

static void net_event_handler(struct net_mgmt_event_callback *cb,
                              uint64_t mgmt_event, struct net_if *iface) {
  const struct wifi_status *status = (const struct wifi_status *)cb->info;

  LOG_INF("NET event - layer: %llx code: %llx cmd: %llx status: %d",
          NET_MGMT_GET_LAYER(mgmt_event), NET_MGMT_GET_LAYER_CODE(mgmt_event),
          NET_MGMT_GET_COMMAND(mgmt_event), status->status);

  switch (mgmt_event) {
  case NET_EVENT_IPV4_ADDR_ADD:
    k_event_set(&net_event, NET_EVENT_IPV4_ADDR_ADD);
    LOG_INF("IPv4 address added");
    break;
  case NET_EVENT_IPV4_DHCP_BOUND:
    k_event_set(&net_event, NET_EVENT_IPV4_DHCP_BOUND);
    LOG_INF("DHCP bound - we have an IP address!");
    break;
  case NET_EVENT_IPV6_ADDR_ADD:
    k_event_set(&net_event, NET_EVENT_IPV6_ADDR_ADD);
    LOG_INF("IPv6 address added");
    break;
  default:
    break;
  }
}

static void dhcp_event_handler(struct net_mgmt_event_callback *cb,
                               uint32_t mgmt_event, struct net_if *iface) {
  if (mgmt_event == NET_EVENT_IPV4_DHCP_BOUND) {
    LOG_INF("DHCP bound - we have an IP address!");

    // Get the assigned IP
    struct in_addr *addr =
        net_if_ipv4_get_global_addr(iface, NET_ADDR_PREFERRED);
    if (addr) {
      char ip_str[NET_IPV4_ADDR_LEN];
      net_addr_ntop(AF_INET, addr, ip_str, sizeof(ip_str));
      LOG_INF("IP Address: %s", ip_str);
    }
  }
}

extern int connect_to_broker(void);
int main(void) {
  int fd;
  int bytes_sent;
  int bytes_recvd;
  struct net_if *iface;
  struct in_addr *if_addr;
  struct wifi_connect_req_params config = {0};
  struct wifi_iface_status status = {0};
  struct wifi_version version = {0};

  uint32_t events;

  char if_addr_s[NET_IPV4_ADDR_LEN];

  LOG_INF("Starting Wi-Fi station MQTT client...");

  iface = net_if_get_wifi_sta();
  if (iface == NULL) {
    LOG_INF("Cannot find the Wi-Fi interface");
    return 0;
  }

  net_mgmt_init_event_callback(&cb, wifi_event_handler,
                               NET_EVENT_WIFI_CONNECT_RESULT);
  net_mgmt_add_event_callback(&cb);

  net_mgmt_init_event_callback(&cb1, net_event_handler,
                               NET_EVENT_IPV4_ADDR_ADD |
                                   NET_EVENT_IPV4_DHCP_BOUND);
  net_mgmt_add_event_callback(&cb1);

  if (net_mgmt(NET_REQUEST_WIFI_VERSION, iface, &version, sizeof(version)) ==
      0) {
    LOG_INF("Wi-Fi Driver Version: %s", version.drv_version);
    LOG_INF("Wi-Fi Firmware Version: %s", version.fw_version);
  }

  config.ssid = (const uint8_t *)WIFI_SSID;
  config.ssid_length = strlen(WIFI_SSID);
  config.psk = (const uint8_t *)WIFI_PSK;
  config.psk_length = strlen(WIFI_PSK);
  config.security = WIFI_SECURITY_TYPE_PSK;
  config.channel = WIFI_CHANNEL_ANY;
  config.band = WIFI_FREQ_BAND_2_4_GHZ;

  do {
    LOG_INF("Connecting to network (SSID: %s)", config.ssid);

    if (net_mgmt(NET_REQUEST_WIFI_CONNECT, iface, &config,
                 sizeof(struct wifi_connect_req_params))) {
      LOG_INF("Wi-Fi connect request failed");
      return 0;
    }

    events = k_event_wait(&connect_event, WIFI_EVENT_ALL, true, K_FOREVER);
    if (events == WIFI_EVENT_CONNECT_SUCCESS) {
      LOG_INF("Joined network!");
      break;
    }
  } while (1);

  do {
    events = k_event_wait(&net_event, NET_EVENT_ALL, true, K_FOREVER);
    if (events & NET_EVENT_IPV4_DHCP_BOUND) {
      LOG_INF("DHCP lease received!");
      break;
    }
  } while (1);

#if defined(CONFIG_SHIELD_RENESAS_QCIOT_RRQ61051EVZ_PMOD)
  do {
    LOG_INF("Waiting for IP address to be assigned...");

    if_addr = net_if_ipv4_get_global_addr(iface, NET_ADDR_PREFERRED);

    if (if_addr) {
      net_addr_ntop(AF_INET, if_addr->s4_addr, if_addr_s, sizeof(if_addr_s));
      LOG_INF("Address: %s", if_addr_s);
    } else {
      k_msleep(1000);
    }
  } while (if_addr == NULL);
#else
  k_msleep(3000);
#endif

  if (net_mgmt(NET_REQUEST_WIFI_IFACE_STATUS, iface, &status,
               sizeof(struct wifi_iface_status))) {
    LOG_INF("Wi-Fi iface status request failed");
    return 0;
  }
  print_wifi_status(&status);

  connect_to_broker();
  while (1) {
    k_msleep(3000);
  }

  return 0;
}

static void print_wifi_status(struct wifi_iface_status *status) {
  LOG_INF("wifi_iface_status - state: %s", wifi_state_txt(status->state));
  LOG_INF("wifi_iface_status - ssid_len: %d", status->ssid_len);
  LOG_INF("wifi_iface_status - ssid: %s", status->ssid);
  LOG_INF("wifi_iface_status - bssid: %x:%x:%x:%x:%x:%x", status->bssid[0],
          status->bssid[1], status->bssid[2], status->bssid[3],
          status->bssid[4], status->bssid[5]);
  LOG_INF("wifi_iface_status - band: %s", wifi_band_txt(status->band));
  LOG_INF("wifi_iface_status - channel: %d", status->channel);
  LOG_INF("wifi_iface_status - iface_mode: %s",
          wifi_mode_txt(status->iface_mode));
  LOG_INF("wifi_iface_status - link_mode: %s",
          wifi_link_mode_txt(status->link_mode));
  LOG_INF("wifi_iface_status - security: %s",
          wifi_wpa3_enterprise_txt(status->wpa3_ent_type));
  LOG_INF("wifi_iface_status - security: %s",
          wifi_security_txt(status->security));
  LOG_INF("wifi_iface_status - mfp: %s", wifi_mfp_txt(status->mfp));
  LOG_INF("wifi_iface_status - rssi: %d", status->rssi);
  LOG_INF("wifi_iface_status - dtim_period: %d", status->dtim_period);
  LOG_INF("wifi_iface_status - beacon_interval: %d", status->beacon_interval);
  LOG_INF("wifi_iface_status - twt_capable: %d", status->twt_capable);
  LOG_INF("wifi_iface_status - current_phy_tx_rate: %f",
          (double)status->current_phy_tx_rate);
}
```

## src/renesas_mqtt_test.c
```c
#include <zephyr/kernel.h>
#include <zephyr/logging/log.h>
#include <zephyr/net/mqtt.h>
#include <zephyr/net/socket.h>
#include <zephyr/net/socket_poll.h>

LOG_MODULE_REGISTER(mqtt_test, LOG_LEVEL_DBG);

#define MQTT_CLIENTID "--->>> zephyr MQTT client <<<---"
// #define MQTT_BROKER_ADDR "3.122.182.249"
#define MQTT_BROKER_ADDR "192.168.3.224"
#define MQTT_BROKER_PORT 1885

static struct mqtt_client client;
static struct sockaddr_storage broker;
static uint8_t rx_buffer[256];
static uint8_t tx_buffer[256];

static bool can_publish = false;

/* Thread for processing mqtt incoming packets */
#define CONFIG_MQTT_THREAD_STACK_SIZE 3200
static void mqtt_comm_thread(void *arg1, void *arg2, void *arg3);
#define MQTT_THREAD_PRIORITY 5
K_THREAD_DEFINE(mqtt_thread, K_THREAD_STACK_LEN(CONFIG_MQTT_THREAD_STACK_SIZE),
                mqtt_comm_thread, &client, NULL, NULL, MQTT_THREAD_PRIORITY, 0,
                0);

static void mqtt_publish_data(void) {
  int ret;

  const uint8_t *topic_str = "zephyr/mqtt/test/data";
  struct mqtt_publish_param param = {0};
  uint8_t data[] = "The quick brown fox jumps over the lazy dog.";

  if (!can_publish) {
    LOG_ERR("Can't publish yet");
    return;
  }

  param.message.topic.qos = MQTT_QOS_0_AT_MOST_ONCE;
  param.message.topic.topic.utf8 = topic_str;
  param.message.topic.topic.size = strlen(topic_str);

  param.message.payload.data = data;
  param.message.payload.len = sizeof(data);

  param.message_id = 666;
  param.dup_flag = 0;
  param.retain_flag = 0;

  LOG_HEXDUMP_DBG(param.message.payload.data, param.message.payload.len,
                  "pub message");

  ret = mqtt_publish(&client, &param);
  LOG_ERR("TEST MQTT PUBLISH: %d (%s)", ret, strerror(-ret));
}

static ssize_t handle_published_message(struct mqtt_client *client,
                                        const struct mqtt_publish_param *pub) {
  int ret;
  size_t received = 0u;
  size_t message_len = pub->message.payload.len;
  static uint8_t payload_buf[1024];

  LOG_INF("RECEIVED on topic \"%.*s\" [ id: %u qos: %u ] payload: %u B",
          pub->message.topic.topic.size,
          (const char *)pub->message.topic.topic.utf8, pub->message_id,
          pub->message.topic.qos, message_len);

  do {
    ret = mqtt_read_publish_payload_blocking(client, &payload_buf[received],
                                             message_len - received);
    if (ret == 0) {
      break;
    }

    if (ret == -EAGAIN) {
      continue;
    }

    received += ret;
  } while (received < message_len);

  if (received != message_len) {
    LOG_ERR("Received data size mismatch %d != %d", received, message_len);

    return -ESPIPE;
  }

  LOG_HEXDUMP_DBG(payload_buf, received, "pub rec:");

  /* Send ACK */
  switch (pub->message.topic.qos) {
  case MQTT_QOS_0_AT_MOST_ONCE:
    break;
  case MQTT_QOS_1_AT_LEAST_ONCE:
    mqtt_publish_qos1_ack(client, &(struct mqtt_puback_param){pub->message_id});
    break;
  case MQTT_QOS_2_EXACTLY_ONCE:
    mqtt_publish_qos2_receive(client,
                              &(struct mqtt_pubrec_param){pub->message_id});
    break;
  default:
    break;
  }

  if (strncmp(payload_buf, "pubme", received) == 0) {
    LOG_ERR("Try publish data");
    mqtt_publish_data();
  }

  return received;
}

static void mqtt_evt_handler(struct mqtt_client *const c,
                             const struct mqtt_evt *evt) {
  int ret;
  struct mqtt_subscription_list list;
  struct mqtt_topic topics;
  uint8_t *topic_str = "zephyr/mqtt/test";

  switch (evt->type) {
  case MQTT_EVT_CONNACK:
    if (evt->result == 0) {

      LOG_INF("TEST MQTT connected\n");

      int type;
      socklen_t len = sizeof(type);
      getsockopt(c->transport.tcp.sock, SOL_SOCKET, SO_TYPE, &type, &len);
      LOG_ERR("Socket type: %d == %d\n", type, SOCK_STREAM);

      getsockopt(c->transport.tcp.sock, SOL_SOCKET, SO_PROTOCOL, &type, &len);
      LOG_ERR("Socket protocol: %d == %d\n", type, IPPROTO_TCP);

      topics.topic.utf8 = topic_str;
      topics.topic.size = strlen(topic_str);
      topics.qos = MQTT_QOS_1_AT_LEAST_ONCE;

      list.list = &topics;
      list.list_count = 1;
      list.message_id = 1;

      ret = mqtt_subscribe(c, &list);

      LOG_ERR("TEST MQTT SUB: %d (%s)", ret, strerror(-ret));

    } else {
      LOG_INF("MQTT connect failed (%d)\n", evt->result);
    }
    break;
  case MQTT_EVT_DISCONNECT:
    LOG_INF("TEST MQTT disconnected\n");
    can_publish = false;
    break;
  case MQTT_EVT_SUBACK:
    LOG_ERR("TEST MQTT SUBACK: message_id: %d", evt->param.puback.message_id);
    can_publish = true;
    break;
  case MQTT_EVT_PINGRESP:
    LOG_DBG("PONG\\");
    break;
  case MQTT_EVT_PUBLISH:
    LOG_ERR("TEST MQTT RECEIVED PUBLISH");
    handle_published_message(c, &evt->param.publish);
    break;
  default:
    LOG_ERR("TEST Unknown MQTT event: %d", evt->type);
    break;
  }
}

static void mqtt_comm_thread(void *arg1, void *arg2, void *arg3) {
  struct mqtt_client *client = arg1;
  struct zsock_pollfd fds = {0};
  int rc;

  LOG_ERR("MQTT THREAD START");

  for (;;) {

    fds.fd = client->transport.tcp.sock;
    fds.events = ZSOCK_POLLIN;
    fds.revents = 0;

    if (client->transport.tcp.sock <= 0) {
      k_sleep(K_MSEC(3000));
      continue;
    }

    LOG_INF("socket: %d", fds.fd);

    rc = zsock_poll(&fds, 1, -1);
    switch (rc) {
    case 1:
      if (fds.revents & ZSOCK_POLLNVAL) {
        LOG_INF("Socked %d closed", fds.fd);
        return;
      }

      if (fds.revents & ZSOCK_POLLERR) {
        LOG_ERR("Socket error 0x%08x", fds.revents);
      }

      if (fds.revents & ZSOCK_POLLIN) {
        rc = mqtt_input(client);
        if (rc < 0) {
          LOG_ERR("Failed to read MQTT input: %d, %s", rc, strerror(-rc));
        }
      }

      if (fds.revents & ZSOCK_POLLHUP) {
        LOG_ERR("0x%08x: Closing the socket: %d", fds.revents, fds.fd);
      }

      break;
    case 0: /* poll tout */
      break;
    default:
      LOG_ERR("poll err: %d (%d: %s)", rc, errno, strerror(errno));
      k_sleep(K_MSEC(3000));
      break;
    }
  }
}

int connect_to_broker(void) {
  int ret;
  struct sockaddr_in *broker4 = (struct sockaddr_in *)&broker;
  struct sockaddr_in6 *broker6 = (struct sockaddr_in6 *)&broker;
  char addr_str[INET6_ADDRSTRLEN];

  /* Clear the structure completely */
  memset(&broker, 0, sizeof(broker));

  /* Try to parse as IPv6 first if it contains a colon */
  if (strchr(MQTT_BROKER_ADDR, ':')) {
    ret = zsock_inet_pton(AF_INET6, MQTT_BROKER_ADDR, &broker6->sin6_addr);
    if (ret == 1) {
      broker6->sin6_family = AF_INET6;
      broker6->sin6_port = htons(MQTT_BROKER_PORT);
      zsock_inet_ntop(AF_INET6, &broker6->sin6_addr, addr_str,
                      sizeof(addr_str));
      LOG_INF("Using IPv6 broker address: %s", addr_str);
    } else {
      LOG_ERR("Failed to parse IPv6 address: %s", MQTT_BROKER_ADDR);
      return -EINVAL;
    }
  } else {
    /* Try to parse as IPv4 */
    ret = zsock_inet_pton(AF_INET, MQTT_BROKER_ADDR, &broker4->sin_addr);
    if (ret == 1) {
      broker4->sin_family = AF_INET;
      broker4->sin_port = htons(MQTT_BROKER_PORT);
      LOG_INF("Using IPv4 broker address: %s", MQTT_BROKER_ADDR);
    } else {
      LOG_ERR("Invalid IPv4 address format: %s", MQTT_BROKER_ADDR);
      return -EINVAL;
    }
  }

  mqtt_client_init(&client);

  client.broker = &broker;
  client.evt_cb = mqtt_evt_handler;
  client.client_id.utf8 = (uint8_t *)MQTT_CLIENTID;
  client.client_id.size = strlen(MQTT_CLIENTID);

  client.keepalive = 1000;
  client.protocol_version = MQTT_VERSION_3_1_1;

  client.rx_buf = rx_buffer;
  client.rx_buf_size = sizeof(rx_buffer);
  client.tx_buf = tx_buffer;
  client.tx_buf_size = sizeof(tx_buffer);

  client.transport.type = MQTT_TRANSPORT_NON_SECURE;

  ret = mqtt_connect(&client);
  if (ret) {
    LOG_ERR("mqtt_connect failed: %d (%s)\n", ret, strerror(-ret));
    return ret;
  }

  LOG_ERR("TEST MQTT CONNECTED (sock: %d): %d (%s)", client.transport.tcp.sock,
          ret, strerror(-ret));

  return 0;
}
```

## prj.conf
```kconfig
# Copyright (c) 2025 Renesas Electronics Corporation
# SPDX-License-Identifier: Apache-2.0

CONFIG_POSIX_API=y
CONFIG_EVENTS=y

# GPIO Configuration
CONFIG_GPIO=y

# Wi-Fi Configuration
CONFIG_WIFI=y
CONFIG_REBOOT=y
CONFIG_SHELL=y
CONFIG_SHELL_STACK_SIZE=10240

CONFIG_HEAP_MEM_POOL_SIZE=131072
CONFIG_INIT_STACKS=y
CONFIG_THREAD_STACK_INFO=y
CONFIG_STACK_CANARIES=y
CONFIG_SPIN_VALIDATE=n
# Synchronous getaddrinfo() uses this as its DNS query timeout. The default
# (2000 ms) is too short for a DPM cold-wake + eRPC/SPI + network round-trip
# (~2.4 s), which cancels the in-flight query (DNS_EAI_CANCELED = -101) just
# before the reply arrives. Give it enough budget to cover the cold wake.
CONFIG_NET_SOCKETS_DNS_TIMEOUT=10000
# Retry within that budget instead of a single long attempt.
CONFIG_NET_SOCKETS_DNS_BACKOFF_INTERVAL=5000
 
# Network Configuration
CONFIG_NETWORKING=y
CONFIG_NET_NATIVE=y
CONFIG_NET_IPV4=y
CONFIG_NET_IPV6=n
CONFIG_NET_TCP=y
CONFIG_NET_DHCPV4=y
CONFIG_DNS_RESOLVER=y
CONFIG_NET_CONFIG_SETTINGS=y
CONFIG_NET_CONFIG_AUTO_INIT=n

# Network management
CONFIG_NET_MGMT=y
CONFIG_NET_MGMT_EVENT=y
CONFIG_NET_MGMT_EVENT_INFO=y
CONFIG_NET_MGMT_EVENT_QUEUE_SIZE=10
CONFIG_NET_MGMT_EVENT_STACK_SIZE=4096
CONFIG_NET_CONNECTION_MANAGER=y

CONFIG_MAIN_STACK_SIZE=10240
CONFIG_SYSTEM_WORKQUEUE_STACK_SIZE=10240
CONFIG_WIFI_ERPC_WIFI_WORKQ_STACK_SIZE=8192
CONFIG_WIFI_ERPC_WIFI_SERVER_THREAD_STACK_SIZE=8192
CONFIG_NET_SOCKETS_SERVICE_STACK_SIZE=4096

# Network buffers
CONFIG_NET_PKT_RX_COUNT=8
CONFIG_NET_PKT_TX_COUNT=8

# L2 drivers
CONFIG_NET_L2_ETHERNET=y
CONFIG_NET_L2_WIFI_MGMT=y

# LOG — immediate mode has no buffer/thread so LOG_BUFFER_SIZE
# and LOG_PROCESS_THREAD_STACK_SIZE do not exist here.
# NET/SOCKET/KERNEL kept at WRN to avoid flooding UART and
# hiding the poll-task printks that appear before the crash.
CONFIG_LOG=y
CONFIG_LOG_MODE_DEFERRED=y
CONFIG_LOG_BUFFER_SIZE=8192
CONFIG_LOG_PROCESS_THREAD_STACK_SIZE=2048
CONFIG_NET_LOG=n
# Customer runs Wi-Fi driver logs at INF; DBG SPI tracing changes timing.
CONFIG_WIFI_LOG_LEVEL_INF=y
CONFIG_NET_SOCKETS_LOG_LEVEL_DBG=n
CONFIG_NET_L2_WIFI_MGMT_LOG_LEVEL_DBG=n
CONFIG_KERNEL_LOG_LEVEL_WRN=y
CONFIG_THREAD_LOCAL_STORAGE=n
# ===========================================================
# MPU / FAULT DEBUG — verified buildable on nRF5340 Zephyr 4.2
# ===========================================================

# Full register + MPU fault reason on crash
CONFIG_FAULT_DUMP=2

# Hardware MPU guard page at stack bottom (catches stack overflow)
# NOTE: STACK_SENTINEL conflicts with MPU_STACK_GUARD — do not add it
CONFIG_MPU_STACK_GUARD=y
CONFIG_HW_STACK_PROTECTION=y

# Thread name + stack bounds printed in the fault dump
CONFIG_THREAD_NAME=y
CONFIG_THREAD_MONITOR=y
CONFIG_DEBUG_THREAD_INFO=y

# Watchdog support (task watchdog + HW fallback reset)
CONFIG_WATCHDOG=y
CONFIG_TASK_WDT=y
CONFIG_TASK_WDT_HW_FALLBACK=y
CONFIG_TASK_WDT_CHANNELS=4

# Catch NULL / bad-state in kernel before it reaches the MPU
CONFIG_ASSERT=y
CONFIG_ASSERT_LEVEL=2
CONFIG_ASSERT_VERBOSE=y

# Keep debug symbols — required for addr2line to give file+line
# REMOVE this after the bug is fixed (increases binary size)
# CONFIG_DEBUG_OPTIMIZATIONS=y

# Heap stats — reveals if heap returned NULL causing the deref
CONFIG_SYS_HEAP_RUNTIME_STATS=y

# NOTE: EXCEPTION_STACK_TRACE, ARM_UNWIND, COREDUMP are all
# unavailable in Zephyr 4.2.99 for nRF5340. Use addr2line instead
# (see instructions below the conf file).

CONFIG_NET_ZPERF=y
CONFIG_NET_ZPERF_SERVER=y
CONFIG_NET_ZPERF_MAX_PACKET_SIZE=2048
CONFIG_NET_UDP=y
CONFIG_NET_SOCKETS=y
CONFIG_HTTP_CLIENT=y
CONFIG_NET_SHELL=y
# Socket service thread polls ALL static services (DNS resolver, zperf, app
# HTTPS service) + 1 eventfd in one poll(). If the total exceeds
# ZVFS_POLL_MAX the service thread never starts and every
# net_socket_service_register() returns -EIO (DNS reconfigure -5).
CONFIG_ZVFS_POLL_MAX=24
CONFIG_ZVFS_OPEN_MAX=16

# MQTT / TLS
CONFIG_MQTT_LIB=y
CONFIG_MQTT_LIB_TLS=y
CONFIG_TLS_CREDENTIALS=y
CONFIG_NET_SOCKETS_SOCKOPT_TLS=y
CONFIG_MBEDTLS=y
 
# PEM certificate support
CONFIG_MBEDTLS_PEM_CERTIFICATE_FORMAT=y
 
# mbedTLS heap — sized for MQTT + HTTPS Phase 1 handshake/certs.
CONFIG_MBEDTLS_ENABLE_HEAP=y
 
# EC / ECDSA cipher suite support
# CA, broker cert, client cert and private key are all EC P-256 (ECDSA).
CONFIG_MBEDTLS_ECP_C=y
CONFIG_MBEDTLS_ECDH_C=y
CONFIG_MBEDTLS_ECDSA_C=y
CONFIG_MBEDTLS_ECP_DP_SECP256R1_ENABLED=y
CONFIG_MBEDTLS_KEY_EXCHANGE_ECDHE_ECDSA_ENABLED=y
CONFIG_MBEDTLS_KEY_EXCHANGE_ECDHE_RSA_ENABLED=y
# Common cipher / hash primitives
CONFIG_MBEDTLS_CIPHER_AES_ENABLED=y
CONFIG_MBEDTLS_CIPHER_GCM_ENABLED=y
CONFIG_MBEDTLS_SHA256=y
CONFIG_MBEDTLS_SHA384=y
# TLS record buffer — sized for sequential HTTPS then MQTT (not both at once).
# 8 KB is enough for Phase 1 GET body logging; avoids starving MQTT heap.
# Customer repro: real WAN servers can send 16 KB TLS records and RSA chains.
CONFIG_MBEDTLS_SSL_MAX_CONTENT_LEN=16384
CONFIG_MBEDTLS_HEAP_SIZE=81920
CONFIG_NET_SOCKETS_CONNECT_TIMEOUT=15000

# ===========================================================
# Customer-equivalent reproduction (MT_CUSTOMER_REPRO / CUSTOMER_REPRO)
# ===========================================================
# Customer HTTP stack: Zephyr http_client + socket service thread + async DNS
CONFIG_NET_SOCKETS_SERVICE=y
CONFIG_DNS_RESOLVER=y
# Public HTTPS servers (Cloudflare / AWS) need RSA + SNI in mbedTLS
CONFIG_MBEDTLS_RSA_C=y
CONFIG_MBEDTLS_PKCS1_V15=y
CONFIG_MBEDTLS_KEY_EXCHANGE_RSA_ENABLED=y
CONFIG_MBEDTLS_SERVER_NAME_INDICATION=y
# Customer build has IPv6 enabled (link-local address applied by driver).
# Enable to also exercise the driver's IPv6 code paths:
# CONFIG_NET_IPV6=y
# Every log line was printed twice (UART backend + shell backend).
CONFIG_SHELL_LOG_BACKEND=n
CONFIG_ERPC_DATA_PATH=y
```

## boards/nrf5340dk_nrf5340_cpuapp.conf
```kconfig
CONFIG_TEST_RANDOM_GENERATOR=y
CONFIG_MAIN_STACK_SIZE=4096

CONFIG_SHELL=y
CONFIG_SERIAL=y
CONFIG_CONSOLE=y
CONFIG_UART_CONSOLE=y
CONFIG_PRINTK=y
CONFIG_LOG=y
CONFIG_LOG_BACKEND_UART=y
# Deferred logging: immediate UART logging inside the SPI/eRPC path made
# every eRPC call take 600-900 ms and broke the 500 ms PMGR timeout.
CONFIG_LOG_MODE_DEFERRED=y

# # Enable Device PM to suspend Nordic SPIM EasyDMA during DPM
# CONFIG_PM_DEVICE=y
# CONFIG_PM_DEVICE_RUNTIME=y
```

## boards/ek_ra6m4.overlay
```dts
/*
 * Copyright (c) 2025 Renesas Electronics Corporation
 *
 * SPDX-License-Identifier: Apache-2.0
 *
 * Device tree overlay for GPIO wakeup on P206
 */

/ {
    aliases {
        wakeup-gpio = &gpio_wakeup;
    };

    gpio_wakeup {
        compatible = "gpio-leds";
        gpio_wakeup: wakeup_gpio {
            gpios = <&ioport2 6 GPIO_ACTIVE_HIGH>;
            label = "Wakeup GPIO P206";
        };
    };
};
```

## src/https_get.h
```c
/*
 * Phase 4: HTTPS GET provisions MQTT host/port/client_id plus PEM certs.
 * Peer verify disabled for self-signed HTTPS bring-up.
 */
#ifndef HTTPS_GET_H
#define HTTPS_GET_H

#include <stdbool.h>
#include <stddef.h>
#include <stdint.h>

#ifdef __cplusplus
extern "C" {
#endif

#define HTTPS_MQTT_HOST_MAX 64
#define HTTPS_MQTT_ID_MAX   32
/* Room for typical 2K RSA PEM (+ header/footer). */
#define HTTPS_MQTT_PEM_MAX  2048

struct https_mqtt_cfg {
	char host[HTTPS_MQTT_HOST_MAX];
	char client_id[HTTPS_MQTT_ID_MAX];
	uint16_t port;
	bool valid;       /* host/port/client_id parsed */
	bool certs_valid; /* CA + client cert + key parsed */

	char ca_pem[HTTPS_MQTT_PEM_MAX];
	size_t ca_pem_len;
	char client_cert_pem[HTTPS_MQTT_PEM_MAX];
	size_t client_cert_pem_len;
	char private_key_pem[HTTPS_MQTT_PEM_MAX];
	size_t private_key_pem_len;
};

/**
 * HTTPS GET to LAN provision server.
 * Fills @p cfg with MQTT endpoint and optional PEM credentials from JSON.
 * Always closes the TLS socket before return.
 *
 * @return 0 on HTTP/TLS success, negative errno-style value on transport failure
 */
int https_phase1_get(struct https_mqtt_cfg *cfg);

/**
 * Customer-like second HTTPS transaction.
 * Sends a Zephyr http_client POST after bootstrap so the app exercises two
 * consecutive HTTPS requests before MQTT, matching the customer flow.
 *
 * @return 0 on transport success, negative errno-style value on transport failure
 */
int https_onboard_post_probe(const struct https_mqtt_cfg *cfg);

#ifdef __cplusplus
}
#endif

#endif /* HTTPS_GET_H */
```
